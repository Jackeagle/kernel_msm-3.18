## Documentation/devicetree/bindings/clock/qcom,sm8150-gpucc.yaml
```yaml
# SPDX-License-Identifier: GPL-2.0-only
%YAML 1.2
---
$id: http://devicetree.org/schemas/clock/qcom,sm8150-gpucc.yaml#
$schema: http://devicetree.org/meta-schemas/core.yaml#

title: Qualcomm Graphics Clock & Reset Controller Binding for SM8150

maintainers:
  -

description: |
  Qualcomm graphics clock control module which supports the clocks, resets and
  power domains on SM8150.

  See also dt-bindings/clock/qcom,gpucc-sm8150.h.

properties:
  compatible:
    const: qcom,sm8150-gpucc

  clocks:
    items:
      - description: Board XO source
      - description: GPLL0 main branch source
      - description: GPLL0 div branch source

  clock-names:
    items:
      - const: bi_tcxo
      - const: gcc_gpu_gpll0_clk_src
      - const: gcc_gpu_gpll0_div_clk_src

  '#clock-cells':
    const: 1

  '#reset-cells':
    const: 1

  '#power-domain-cells':
    const: 1

  reg:
    maxItems: 1

required:
  - compatible
  - reg
  - clocks
  - clock-names
  - '#clock-cells'
  - '#reset-cells'
  - '#power-domain-cells'

additionalProperties: false

examples:
  - |
    #include <dt-bindings/clock/qcom,gcc-sm8150.h>
    #include <dt-bindings/clock/qcom,rpmh.h>
    clock-controller@2c90000 {
      compatible = "qcom,sm8150-gpucc";
      reg = <0x2c90000 0x9000>;
      clocks = <&rpmhcc RPMH_CXO_CLK>,
               <&gcc GCC_GPU_GPLL0_CLK_SRC>,
               <&gcc GCC_GPU_GPLL0_DIV_CLK_SRC>;
      clock-names = "bi_tcxo",
                    "gcc_gpu_gpll0_clk_src",
                    "gcc_gpu_gpll0_div_clk_src";
      #clock-cells = <1>;
      #reset-cells = <1>;
      #power-domain-cells = <1>;
    };
...
```

## Documentation/devicetree/bindings/display/bridge/ite,it6505.txt
```
iTE it6505 DP bridge bindings

Required properties:
        - compatible: "ite,it6505"
        - reg: i2c address of the bridge
        - ovdd-supply: I/O voltage
        - pwr18-supply: Core voltage
        - interrupts: interrupt specifier of INT pin
        - reset-gpios: gpio specifier of RESET pin
	- hpd-gpios:
		Hotplug detect GPIO.
		Indicates which GPIO should be used for hotplug detection
	- port@[x]: SoC specific port nodes with endpoint definitions as defined
		in Documentation/devicetree/bindings/display/mediatek/mediatek,dpi.txt

Example:
	dp-bridge@5c {
                compatible = "ite,it6505";
                interrupts = <152 IRQ_TYPE_EDGE_RISING 152 0>;
                reg = <0x5c>;
                pinctrl-names = "default";
                pinctrl-0 = <&it6505_pins>;
                ovdd-supply = <&mt6358_vsim1_reg>;
                pwr18-supply = <&it6505_pp18_reg>;
                reset-gpios = <&pio 179 1>;
                hpd-gpios = <&pio 9 0>;
                extcon = <&usbc_extcon>;
        };
```

## Documentation/devicetree/bindings/input/input.yaml
```yaml
# SPDX-License-Identifier: (GPL-2.0 OR BSD-2-Clause)
%YAML 1.2
---
$id: http://devicetree.org/schemas/input/input.yaml#
$schema: http://devicetree.org/meta-schemas/core.yaml#

title: Common input schema binding

maintainers:
  - Dmitry Torokhov <dmitry.torokhov@gmail.com>

properties:
  linux,keycodes:
    description:
      Specifies an array of numeric keycode values to be used for reporting
      button presses. The array can contain up to 12 entries.
    allOf:
      - $ref: /schemas/types.yaml#/definitions/uint32-array
      - items:
          minimum: 0
          maximum: 0xff

  autorepeat:
    description: Enable autorepeat when key is pressed and held down.
    type: boolean
```

## Documentation/devicetree/bindings/leds/leds-lt3593.txt
```
Bindings for Linear Technologies LT3593 LED controller

Required properties:
- compatible:	Should be "lltc,lt3593".

The hardware supports only one LED. The properties of this LED are
configured in a sub-node in the device node.

Required sub-node properties:
- gpios:	A handle to the GPIO that is connected to the 'CTRL'
		pin of the chip.

Optional sub-node properties:
- label:	A label for the LED. If none is given, the LED will be
		named "lt3595::".
- linux,default-trigger: The default trigger for the LED.
			See Documentation/devicetree/bindings/leds/common.txt
- default-state:	The initial state of the LED.
			See Documentation/devicetree/bindings/leds/common.txt

If multiple chips of this type are found in a design, each one needs to
be handled by its own device node.

Example:

led-controller {
	compatible = "lltc,lt3593";

	led {
		label = "white:backlight";
		gpios = <&gpio 0 GPIO_ACTIVE_HIGH>;
		default-state = "on";
	};
};
```

## Documentation/devicetree/bindings/net/msm_nss_crypto.txt
```
* Qualcomm Technologies Inc. Crypto Platform Driver.

This driver configures the crypto engine for IPSec traffic in UBI32.

Required properties:
- compatible: Should be qcom,nss-crypto
- reg: Physical address and length of the register set for the device.
- qcom,ee: Number of interrupt lines(Execution Environments) supported by BAM.

Optional properties:
- qcom,secure-mode-enabled: Enables the HW to store keys securely.
  If secure-mode is enabled, non-secure mode is fully disabled.

Example:

crypto0: crypto@e8000000 {
	 compatible = "qcom,nss-crypto";
	 reg-names = "crypto_pbase", "bam_base";
	 reg = <0xe8000000 0x20000>,
	     <0xe8004000 0x22000>;
	 qcom,ee = <0>;
	 qcom,secure-mode-enabled;
};
```
